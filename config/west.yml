## config/west.yml
```yaml
manifest:
  defaults:
    revision: v0.3
  remotes:
    - name: zmkfirmware
      url-base: https://github.com/zmkfirmware
    - name: infely 
      url-base: https://github.com/infely
    - name: janpfischer
      url-base: https://github.com/janpfischer
    - name: petejohanson
      url-base: https://github.com/petejohanson/
    - name: caksoylar
      url-base: https://github.com/caksoylar
  projects:
    - name: zmk
      remote: zmkfirmware
      import: app/west.yml
    - name: nice-view-battery
      remote: infely
      revision: main
    - name: zmk-dongle-screen
      remote: janpfischer
      revision: main
    - name: cirque-input-module
      remote: petejohanson
      revision: main
    - name: zmk-rgbled-widget
      remote: caksoylar
      revision: main
  self:
    path: config
```
